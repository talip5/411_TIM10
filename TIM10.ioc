# file: TIM10.ioc
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Mcu.Family=STM32F4
Mcu.Name=STM32F411V(C-E)Tx
Mcu.Package=LQFP100
NVIC.PriorityGroup=NVIC_PRIORITYGROUP_0
PH0\ -\ OSC_IN.Mode=HSE-External-Oscillator
PH0\ -\ OSC_IN.Signal=RCC_OSC_IN
PH1\ -\ OSC_OUT.Mode=HSE-External-Oscillator
PH1\ -\ OSC_OUT.Signal=RCC_OSC_OUT
ProjectManager.HeapSize=0x200
ProjectManager.StackSize=0x400
ProjectManager.TargetToolchain=STM32CubeIDE
RCC.48MHZClocksFreq_Value=24000000
RCC.AHBCLKDivider=RCC_SYSCLK_DIV128
RCC.AHBFreq_Value=750000
RCC.APB1CLKDivider=RCC_HCLK_DIV2
RCC.APB1Freq_Value=375000
RCC.APB1TimFreq_Value=750000
RCC.APB2CLKDivider=RCC_HCLK_DIV4
RCC.APB2Freq_Value=187500
RCC.APB2TimFreq_Value=375000
RCC.CortexFreq_Value=750000
RCC.HCLKFreq_Value=750000
RCC.HSE_VALUE=8000000
RCC.HSI_VALUE=16000000
RCC.LSE_VALUE=32768
RCC.PLLI2SM=5
RCC.PLLI2SN=200
RCC.PLLM=4
RCC.PLLN=96
RCC.PLLQ=8
RCC.PLLSourceVirtual=RCC_PLLSOURCE_HSE
RCC.SYSCLKFreq_VALUE=96000000
RCC.SYSCLKSource=RCC_SYSCLKSOURCE_PLLCLK
RCC.VCOOutputFreq_Value=192000000
board=STM32F411E-DISCO

// file: Core/Src/main.c
/* USER CODE BEGIN Header */
/**
  ******************************************************************************
  * @file           : main.c
  * @brief          : Main program body
  ******************************************************************************
  * @attention
  *
  * Copyright (c) 2024 STMicroelectronics.
  * All rights reserved.
  *
  * This software is licensed under terms that can be found in the LICENSE file
  * in the root directory of this software component.
  * If no LICENSE file comes with this software, it is provided AS-IS.
  *
  ******************************************************************************
  */
/* USER CODE END Header */
#include "main.h"

/* USER CODE BEGIN PD */
void Led_Init(void);
void Led_On(void);
void Led_Off(void);

void time1(void);

void Timer10_Init(void);
void Timer10_Enable(void);
void Timer10_Disable(void);

/* USER CODE END PD */

/* USER CODE BEGIN PV */
uint16_t counter1=0;
uint16_t counter2=0;
uint16_t no=0;
uint16_t number1=0;
/* USER CODE END PV */

void SystemClock_Config(void);
static void MX_GPIO_Init(void);

int main(void)
{

  /* MCU Configuration--------------------------------------------------------*/

  /* Reset of all peripherals, Initializes the Flash interface and the Systick. */
  HAL_Init();

  /* Configure the system clock */
  SystemClock_Config();

  /* Initialize all configured peripherals */
  MX_GPIO_Init();
  /* USER CODE BEGIN 2 */
  Led_Init();

  Timer10_Init();
  Timer10_Enable();

  /* USER CODE END 2 */

  /* Infinite loop */
  /* USER CODE BEGIN WHILE */
  while (1)
  {
	  //counter1=TIM10->SR;
	  counter1=TIM10->SR & TIM_SR_UIF;
	  if(counter1==1)
	  {
		  GPIOD->ODR |=GPIO_ODR_OD15;

	  }

	 counter2=TIM10->CNT;
	 //number1++;
	 // if(counter1>38){
		//  Led_On();
	 // }
    /* USER CODE END WHILE */

  }
}

void SystemClock_Config(void)
{
  RCC_OscInitTypeDef RCC_OscInitStruct = {0};
  RCC_ClkInitTypeDef RCC_ClkInitStruct = {0};

  /** Configure the main internal regulator output voltage
  */
  __HAL_RCC_PWR_CLK_ENABLE();
  __HAL_PWR_VOLTAGESCALING_CONFIG(PWR_REGULATOR_VOLTAGE_SCALE1);

  /** Initializes the RCC Oscillators according to the specified parameters
  * in the RCC_OscInitTypeDef structure.
  */
  RCC_OscInitStruct.OscillatorType = RCC_OSCILLATORTYPE_HSE;
  RCC_OscInitStruct.HSEState = RCC_HSE_ON;
  RCC_OscInitStruct.PLL.PLLState = RCC_PLL_ON;
  RCC_OscInitStruct.PLL.PLLSource = RCC_PLLSOURCE_HSE;
  RCC_OscInitStruct.PLL.PLLM = 4;
  RCC_OscInitStruct.PLL.PLLN = 96;
  RCC_OscInitStruct.PLL.PLLP = RCC_PLLP_DIV2;
  RCC_OscInitStruct.PLL.PLLQ = 8;
  if (HAL_RCC_OscConfig(&RCC_OscInitStruct) != HAL_OK)
  {
    Error_Handler();
  }

  /** Initializes the CPU, AHB and APB buses clocks
  */
  RCC_ClkInitStruct.ClockType = RCC_CLOCKTYPE_HCLK|RCC_CLOCKTYPE_SYSCLK
                              |RCC_CLOCKTYPE_PCLK1|RCC_CLOCKTYPE_PCLK2;
  RCC_ClkInitStruct.SYSCLKSource = RCC_SYSCLKSOURCE_PLLCLK;
  RCC_ClkInitStruct.AHBCLKDivider = RCC_SYSCLK_DIV128;
  RCC_ClkInitStruct.APB1CLKDivider = RCC_HCLK_DIV2;
  RCC_ClkInitStruct.APB2CLKDivider = RCC_HCLK_DIV4;

  if (HAL_RCC_ClockConfig(&RCC_ClkInitStruct, FLASH_LATENCY_0) != HAL_OK)
  {
    Error_Handler();
  }
}

static void MX_GPIO_Init(void)
{

  /* GPIO Ports Clock Enable */
  __HAL_RCC_GPIOH_CLK_ENABLE();

}

/* USER CODE BEGIN 4 */

void Led_Init()
{
	RCC->AHB1ENR |=RCC_AHB1ENR_GPIODEN;
	GPIOD->MODER |=GPIO_MODER_MODER15_0;
	GPIOD->MODER &=~(GPIO_MODER_MODE15_1);
	GPIOD->OTYPER &=~(GPIO_OTYPER_OT15);
	GPIOD->OSPEEDR &=~(GPIO_OSPEEDER_OSPEEDR15_0);
	GPIOD->OSPEEDR &=~(GPIO_OSPEEDER_OSPEEDR15_1);
	GPIOD->PUPDR &=~(GPIO_PUPDR_PUPD15_0);
	GPIOD->PUPDR &=~(GPIO_PUPDR_PUPD15_1);

}

void Led_On()
{
	GPIOD->ODR |=GPIO_ODR_OD15;
}

void Led_Off()
{
	GPIOD->ODR &=~(GPIO_ODR_OD15);
}

void time1()
{
	for (int var = 0; var < 10000000; ++var) {

	}
}

void Timer10_Init(void){

	//Enable TIM10 Clock
	__HAL_RCC_TIM10_CLK_ENABLE();

	// Timer Clock  48 Mhz / 48.000 = 1000 Hz ( 1ms period )
	TIM10->PSC=37999;

	// Reload in every 500 ms
	TIM10->ARR=100;

	// Enable  Timer Update Interrupt
	TIM10->DIER |=TIM_DIER_UIE;

	// Enable TIM10 Interrupt on NVIC
	NVIC_EnableIRQ(TIM1_UP_TIM10_IRQn);
	NVIC_SetPriority(TIM1_UP_TIM10_IRQn,2);

}

void Timer10_Enable(void)
{
	TIM10->CR1 |=TIM_CR1_CEN;
}

void Timer10_Disable(void)
{
	TIM10->CR1 &=~(TIM_CR1_CEN);
}

void TIM1_UP_TIM10_IRQHandler(void)
{
	//GPIOD->ODR |=GPIO_ODR_OD15;

	//TIM10->SR &=~(TIM_SR_UIF);

	no=no+1;
}
/* USER CODE END 4 */

void Error_Handler(void)
{
  __disable_irq();
  while (1)
  {
  }
}
